#include <U8g2lib.h>
#include <Wire.h>
#include <STM32FreeRTOS.h>

//Pin definitions

//Row select and enable
const int RA0_PIN = D3;
const int RA1_PIN = D6;
const int RA2_PIN = D12;
const int REN_PIN = A5;

//Matrix input and output
const int C0_PIN = A2;
const int C1_PIN = D9;
const int C2_PIN = A6;
const int C3_PIN = D1;
const int OUT_PIN = D11;

//Audio analogue out
const int OUTL_PIN = A4;
const int OUTR_PIN = A3;

//Joystick analogue in
const int JOYY_PIN = A0;
const int JOYX_PIN = A1;

//Output multiplexer bits
const int DEN_BIT = 3;
const int DRST_BIT = 4;
const int HKOW_BIT = 5;
const int HKOE_BIT = 6;



const uint16_t Decay[16384] = {
0, 197, 394, 591, 787, 983, 1178, 1373, 1567, 1761, 1955, 2148,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 17489,
17646, 17802, 17958, 18113, 18268, 18423, 18577, 18731, 18885, 19038, 19191, 19343,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 31379,
31501, 31622, 31743, 31864, 31985, 32105, 32225, 32345, 32464, 32583, 32702, 32820,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 42083,
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0, 0, 0, 0, 0, 0, 0, 0, 0, 0, 0, 0,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 0, 0};



const uint8_t genNotes[12][128] = {
{ 17, 19, 21, 23, 26, 30, 35, 40, 46, 53, 59, 67, 75, 83, 91, 100,
109, 118, 128, 137, 146, 155, 164, 172, 180, 188, 196, 202, 209, 215, 220, 225, 229, 232, 234, 236, 238, 238,
238, 237, 236, 234, 231, 228, 225, 221, 216, 212, 207, 201, 196, 190, 185, 179, 174, 168, 163, 158,
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0, 0, 0, 0, 0, 0, 0, 0},
{
  17, 19, 23, 30, 39, 50, 63, 78, 94, 110,
128, 145, 161, 177, 192, 205, 216, 225, 232, 236, 238, 238, 235, 230, 224, 216, 206, 196, 186, 175,
165, 156, 147, 139, 133, 128, 124, 122, 121, 121, 122, 124, 126, 129, 131, 133, 134, 134, 133, 131,
127, 122, 116, 108, 99, 90, 80, 69, 59, 49, 39, 31, 25, 20, 17, 0, 0, 0, 0, 0, 0, 0, 0, 0, 0, 0, 0, 0, 0, 0,
0, 0, 0, 0, 0, 0, 0, 0, 0, 0, 0, 0, 0, 0, 0, 0, 0, 0, 0, 0,
0, 0, 0, 0, 0, 0, 0, 0, 0, 0, 0, 0, 0, 0, 0, 0, 0, 0, 0, 0,
0, 0, 0, 0, 0, 0, 0, 0}
};

const uint8_t LUTsize[12] = {122,115,109,103,97,92,86,82,77,73,69,65};

const uint32_t stepSizes[12] = { 561836623, 595245168, 630640287, 668140110, 707869788, 749961916, 794556973, 841803789, 891860047, 944892805, 1001079055, 1060606313, }; //for 32kHz sampling frequency

const String notes[12] = { "C", "Db", "D", "Eb", "E", "F", "F#", "G", "G#", "A", "Bb", "B" };

volatile uint8_t knob0 = 4;
volatile uint8_t knob1 = 0;
volatile uint8_t knob3 = 8;

volatile uint32_t matrix = 0xffffffff;
volatile uint32_t remoteMatrix = 0xffffffff;
volatile uint8_t remoteOctave = 4;

//volatile char noteMessage[] = "xxx";
const char intToHex[] = "0123456789ABCDEF";
QueueHandle_t msgOutQ;

const int32_t tangent[10] = { 536870912, 316933405, 167458907, 85004756, 42667331, 21354465, 10679838, 5340245, 2670163, 1335086 };


//Calculate sine using cordic;
// with n iterations;
uint32_t sine(uint32_t angle, int8_t n = 5){
  int32_t x = 3535815245;          //0.6074
  int32_t y = 0;           //0
  int32_t z;
  int32_t new_x, new_y;

  if (angle>>30 == 1) { z = angle - 1<<30; }
  else if (angle>>30 == 2) { z = angle + 1<<30; }
  z = angle;
  
  for (int i = 0; i < n; i++) {
    if (z < 0) {
       new_x = x + (y >> i);
       new_y = y - (x >> i);
       z = z + tangent[i];
     }else{
       new_x = x - (y >> i);
       new_y = y + (x >> i);
       z = z - tangent[i];
     }
     x = new_x;
     y = new_y;
  }
  return y;
}


//Display driver object
U8G2_SSD1305_128X32_NONAME_F_HW_I2C u8g2(U8G2_R0);

//Function to set outputs via matrix
void setOutMuxBit(const uint8_t bitIdx, const bool value) {
  digitalWrite(REN_PIN,LOW);
  digitalWrite(RA0_PIN, bitIdx & 0x01);
  digitalWrite(RA1_PIN, bitIdx & 0x02);
  digitalWrite(RA2_PIN, bitIdx & 0x04);
  digitalWrite(OUT_PIN,value);
  digitalWrite(REN_PIN,HIGH);
  delayMicroseconds(2);
  digitalWrite(REN_PIN,LOW);
}

uint8_t readCols(){
  uint8_t result = digitalRead(C3_PIN)*8 +
  digitalRead(C2_PIN)*4 +
  digitalRead(C1_PIN)*2 +
  digitalRead(C0_PIN);
  return result;
}

void setRow(uint8_t rowIdx){
  uint8_t ra0 = rowIdx & 0x01;
  uint8_t ra1 = (rowIdx & 0x02) >> 1;
  uint8_t ra2 = (rowIdx & 0x04) >> 2;
  digitalWrite(REN_PIN, LOW);
  digitalWrite(RA0_PIN, ra0);
  digitalWrite(RA1_PIN, ra1);
  digitalWrite(RA2_PIN, ra2);
  digitalWrite(REN_PIN, HIGH);
}


void sampleISR() {
  static uint32_t phaseAccs[12] = {0, 0, 0, 0, 0, 0, 0, 0, 0, 0, 0, 0};
  static uint16_t decayCounts[12] = {0, 0, 0, 0, 0, 0, 0, 0, 0, 0, 0, 0};
  static uint32_t remotePhaseAccs[12] = {0, 0, 0, 0, 0, 0, 0, 0, 0, 0, 0, 0};
  uint32_t currentMatrix = __atomic_load_n(&matrix, __ATOMIC_RELAXED);
  uint32_t currentRemoteMatrix = __atomic_load_n(&remoteMatrix, __ATOMIC_RELAXED);
  uint8_t sine_wave = false;
  static uint16_t sustain = 0;
  uint32_t outValue = 0;
  uint16_t count = 0;
  uint16_t singleCount = 0;
  uint8_t polyphonyLimit = 0;
  
  for (int i=0; i<12; i++) {
    if (!((currentMatrix>>i)&1)) {count++; singleCount++;}
    if (!((currentRemoteMatrix>>i)&1)) count++;
  }
  if (singleCount == 0) singleCount = 1;
  if (count == 0) count = 1;
  
  for (int i=0; i<12; i++) {  
    if ((knob1 == 0) | (knob1 == 1)) {
      if ((currentMatrix>>i)&1) phaseAccs[i] = 0; //if key i not pressed
      else{
        phaseAccs[i] += (stepSizes[i] >> (8-knob0));
        if (knob3 >= 8) outValue += (phaseAccs[i]/count) >> 24 >> (8-knob3/2);
        else outValue += (phaseAccs[i]) >> 24 >> (8-knob3/2);
      }
      if ((currentRemoteMatrix>>i)&1) remotePhaseAccs[i] = 0; //if remote key i not pressed    
      else{
        remotePhaseAccs[i] += (stepSizes[i] >> (8-remoteOctave));
        if (knob3 >= 8) outValue += (remotePhaseAccs[i]/count) >> 24 >> (8-knob3/2);
        else outValue += (remotePhaseAccs[i]) >> 24 >> (8-knob3/2);
      }
    }else if((knob1 == 2) | (knob1 == 3)) {
      if (!((currentMatrix>>i)&1)) {
        polyphonyLimit ++;
        if (polyphonyLimit <= 1) {
          phaseAccs[i] += (stepSizes[i] >> (8-knob0));
          outValue = (sine(phaseAccs[i])) >> 24 >> (8-knob3/2);
        }
      }else phaseAccs[i] = 0;
    }else{
      if ((currentMatrix>>i)&1) {
         phaseAccs[i] = 0;
         decayCounts[i] = 0;
      }else{
        polyphonyLimit++;
        if (polyphonyLimit <= 3) {
          phaseAccs[i] += 1;
          if ((phaseAccs[i] >= LUTsize[i]) ) phaseAccs[i] = 0;
          if (knob3 >= 11) outValue += (((genNotes[i][phaseAccs[i]]*Decay[decayCounts[i]]/singleCount >> 16)) >> (8-knob3/2));
          else outValue += (((genNotes[i][phaseAccs[i]]*Decay[decayCounts[i]]) >> 16)) >> (8-knob3/2);
          sustain++;
          if (sustain > 10) {
            sustain = 0;
            if (decayCounts[i]<= 16382) decayCounts[i] += 1;
            else decayCounts[i] = 16383;
          }
        }
      }
    }      
  }
  analogWrite(OUTR_PIN, outValue);
}


void displayUpdateTask(void *pvParameters){
  const TickType_t xFrequency = 100/portTICK_PERIOD_MS;
  TickType_t xLastWakeTime = xTaskGetTickCount();
   while(1) {
    vTaskDelayUntil(&xLastWakeTime, xFrequency);
     //Update display
    u8g2.clearBuffer();
    u8g2.setFont(u8g2_font_profont10_tr);
    uint32_t tempMatrix = __atomic_load_n(&matrix, __ATOMIC_RELAXED);
    uint8_t tempKnob0 = __atomic_load_n(&knob0, __ATOMIC_RELAXED);
    uint8_t tempKnob1 = __atomic_load_n(&knob1, __ATOMIC_RELAXED);
    uint8_t tempKnob3 = __atomic_load_n(&knob3, __ATOMIC_RELAXED);
    for (int i=0; i<12; i++) {
      if (!((tempMatrix>>i)&1)) u8g2.drawStr(7+i*10,10,notes[i].c_str());
    }
    u8g2.drawStr(2,20,"INS"); 
    u8g2.setCursor(7,30);
    u8g2.print(tempKnob1/2, DEC);
    u8g2.drawStr(38,20,"OCT"); 
    u8g2.setCursor(44,30);
    u8g2.print(tempKnob0, DEC);
    u8g2.drawStr(78,20,"VOL"); 
    u8g2.setCursor(80,30);
    u8g2.print(tempKnob3, DEC);
    u8g2.sendBuffer(); // transfer internal memory to the display
  }
}

void detectKnobRotation(uint8_t knob, uint8_t previous, uint8_t current){
    int8_t shift = 0;
    if (previous == 0 && current == 1) shift = 1;
    else if (previous == 0 && current == 2) shift = -1;
    else if (previous == 1 && current == 0) shift = -1;
    else if (previous == 1 && current == 3) shift = 1;
    else if (previous == 2 && current == 0) shift = 1;
    else if (previous == 2 && current == 3) shift = -1;
    else if (previous == 3 && current == 1) shift = -1;
    else if (previous == 3 && current == 1) shift = 1;
    if (knob == 1) {
      int8_t temp = __atomic_load_n(&knob1, __ATOMIC_RELAXED) + shift;
      if (temp > 4) temp = 4; if (temp < 0) temp = 0;
      __atomic_store_n(&knob1, temp, __ATOMIC_RELAXED);
    }else if (knob == 3) {
      int8_t temp = __atomic_load_n(&knob3, __ATOMIC_RELAXED) + shift;
      if (temp > 16) temp = 16; if (temp < 0) temp = 0;
      __atomic_store_n(&knob3, temp, __ATOMIC_RELAXED);
    }else if (knob == 0) {
      int8_t temp = __atomic_load_n(&knob0, __ATOMIC_RELAXED) + shift;
      if (temp > 8) temp = 8; if (temp < 0) temp = 0;
      __atomic_store_n(&knob0, temp, __ATOMIC_RELAXED);
    }
  }

void scanKeysTask(void *pvParameters){
  const TickType_t xFrequency = 20/portTICK_PERIOD_MS;
  TickType_t xLastWakeTime = xTaskGetTickCount();
  Serial.println("scanning");
  uint32_t startTime = micros();
  while (1) {
    char noteMessage[] = "xxx";
    vTaskDelayUntil(&xLastWakeTime, xFrequency);
    uint16_t currentPressed = 0;
    uint8_t current0, previous0, current1, previous1, current3, previous3 = 0;
    uint32_t newMatrix = 0;
    for (int i = 0; i < 8; i++) {
      setRow(i);
      delayMicroseconds(3);
      uint8_t row_i = readCols();
      newMatrix = newMatrix | (row_i << i*4);
    }
    
    uint32_t oldMatrix = __atomic_load_n(&matrix, __ATOMIC_RELAXED);
    previous0 = (oldMatrix >> 16) & 3; current0 =  (newMatrix >> 16) & 3;
    previous3 = (oldMatrix >> 14) & 3; current3 = (newMatrix >> 14) & 3;
    previous1 = (oldMatrix >> 18) & 3; current1 = (newMatrix >> 18) & 3; 

    bool keyChange = false;
    //atomic load here
    uint8_t tempKnob0 = __atomic_load_n(&knob0, __ATOMIC_RELAXED);
    for (int i = 0; i<12; i++){
      if (((oldMatrix >> i)&1) && !((newMatrix >> i)&1)) {
        keyChange = true;
        noteMessage[0] = 'P';
        //noteMessage[1] =knob0 + '0';
        noteMessage[1] = tempKnob0 + '0';
        noteMessage[2] = intToHex[i];
        xQueueSend( msgOutQ, (char*) noteMessage, portMAX_DELAY);  
      }else if(!((oldMatrix >> i)&1) && ((newMatrix >> i)&1)) {
        keyChange = true;
        noteMessage[0] = 'R';
        //noteMessage[1] = knob0 + '0';
        noteMessage[1] = tempKnob0 + '0';
        noteMessage[2] = intToHex[i];
        xQueueSend( msgOutQ, (char*) noteMessage, portMAX_DELAY);  
      }
    }
    oldMatrix = newMatrix;
    detectKnobRotation(0, previous0, current0);
    detectKnobRotation(1, previous1, current1);
    detectKnobRotation(3, previous3, current3);
      
    __atomic_store_n(&matrix, newMatrix, __ATOMIC_RELAXED);
  }
}

void msgOutTask(void *pvParameters) {
  const TickType_t xFrequency = 20/portTICK_PERIOD_MS;
  TickType_t xLastWakeTime = xTaskGetTickCount();
  char outMsg[4];
  while (1) {
    xQueueReceive(msgOutQ, outMsg, portMAX_DELAY);
    Serial.println(outMsg);
  }
}

void msgInTask(void *pvParameters) {
  const TickType_t xFrequency = 5/portTICK_PERIOD_MS;
  TickType_t xLastWakeTime = xTaskGetTickCount();
  uint32_t counter = 0;
  char inMsg[] = "xxx";
  while (1) {
    while (Serial.available() > 0) {
      char tmp = Serial.read();
      uint32_t newRemoteMatrix = __atomic_load_n(&remoteMatrix, __ATOMIC_RELAXED);
      if (tmp != '\n'){
        inMsg[counter] = tmp;
        counter++;
      }else{
        counter = 0;
        if (inMsg[0] == 'R') {
          uint8_t key = 0;
          if (inMsg[2] == 'B') key = 11;
          else if (inMsg[2] == 'A') key = 10;
          else key = inMsg[2] - '0';
          newRemoteMatrix = newRemoteMatrix | (1 << key);
        }else if(inMsg[0] == 'P') {
          uint8_t key = 0;
          __atomic_store_n(&remoteOctave, inMsg[1] - '0', __ATOMIC_RELAXED);
          if (inMsg[2] == 'B') key = 11;
          else if (inMsg[2] == 'A') key = 10;
          else key = inMsg[2] - '0';
          newRemoteMatrix =  (newRemoteMatrix & (~(1 << key))); //bits 16:12 decode octave, 11:0 key
        }
        __atomic_store_n(&remoteMatrix, newRemoteMatrix , __ATOMIC_RELAXED);
      }
    }
  }
}

void setup() {
  // put your setup code here, to run once:
  
  //Set pin directions
  pinMode(RA0_PIN, OUTPUT);
  pinMode(RA1_PIN, OUTPUT);
  pinMode(RA2_PIN, OUTPUT);
  pinMode(REN_PIN, OUTPUT);
  pinMode(OUT_PIN, OUTPUT);
  pinMode(OUTL_PIN, OUTPUT);
  pinMode(OUTR_PIN, OUTPUT);
  pinMode(LED_BUILTIN, OUTPUT);
  
  pinMode(C0_PIN, INPUT);
  pinMode(C1_PIN, INPUT);
  pinMode(C2_PIN, INPUT);
  pinMode(C3_PIN, INPUT);
  pinMode(JOYX_PIN, INPUT);
  pinMode(JOYY_PIN, INPUT);
  
   //Initialise display
  setOutMuxBit(DRST_BIT, LOW); //Assert display logic reset
  delayMicroseconds(2);
  setOutMuxBit(DRST_BIT, HIGH); //Release display logic reset
  u8g2.begin();
  setOutMuxBit(DEN_BIT, HIGH); //Enable display power supply
  
   //Initialise UART
  Serial.begin(115200);
  Serial.println("Hello World");
  //Global queue
  msgOutQ = xQueueCreate( 8, 4 );
  
  // // Set up timer to trigger the interrupt
  TIM_TypeDef *Instance = TIM1;
  HardwareTimer *sampleTimer = new HardwareTimer(Instance);
  
  sampleTimer->setOverflow(32000,HERTZ_FORMAT);
  sampleTimer->attachInterrupt(sampleISR);
  sampleTimer->resume();
  
  //Create Threads
  TaskHandle_t scanKeysHandle = NULL;
  xTaskCreate(scanKeysTask, "scanKeys", 128, NULL, 3, &scanKeysHandle);
  
  TaskHandle_t dispalyUpdateHandle = NULL;
  xTaskCreate(displayUpdateTask, "displayUpdate", 64, NULL, 4, &dispalyUpdateHandle);
  
  TaskHandle_t msgOutTaskHandle = NULL;
  xTaskCreate(msgOutTask, "msgOut", 64, NULL, 2, &msgOutTaskHandle);
  
  TaskHandle_t msgInTaskHandle = NULL;
  xTaskCreate(msgInTask, "msgIn", 256, NULL, 1, &msgInTaskHandle);
  
  vTaskStartScheduler();
}

void loop() {
}
